## runtime/apps/glass-marble/mosaico/main/Kconfig.projbuild
```kconfig
menu "Glass Marble geometry and mounting"
config GM_MOSAICO_MM
 int "Mosaico active glass width/height (hundredths of a millimetre)"
 range 3000 10000
 default 4000
config GM_X_WIDTH_MM
 int "X1060 active glass width (hundredths of a millimetre)"
 range 2500 10000
 default 3700
config GM_X_HEIGHT_MM
 int "X1060 active glass height (hundredths of a millimetre)"
 range 3000 15000
 default 6660
config GM_GAP_MM
 int "Horizontal active-glass edge gap (hundredths of a millimetre)"
 range 0 5000
 default 800
config GM_OFFSET_MM
 int "X1060 top relative to Mosaico top (hundredths of a millimetre)"
 range -15000 10000
 default -1330
config GM_IMU_ROTATION
 int "IMU in-plane mounting rotation (quarter turns clockwise, 0..3)"
 range 0 3
 default 0
config GM_IMU_X_SIGN
 int "IMU X sign (1 or -1)"
 range -1 1
 default 1
config GM_IMU_Y_SIGN
 int "IMU Y sign (1 or -1)"
 range -1 1
 default 1
endmenu
```

## runtime/apps/glass-marble/mosaico/sdkconfig.defaults
```kconfig
CONFIG_IDF_TARGET="esp32s31"
CONFIG_COMPILER_OPTIMIZATION_PERF=y
CONFIG_FREERTOS_HZ=1000
CONFIG_PARTITION_TABLE_SINGLE_APP_LARGE=y
CONFIG_SPIRAM=y
CONFIG_SPIRAM_SPEED_250M=y
CONFIG_SPIRAM_XIP_FROM_PSRAM=y
CONFIG_SPIRAM_MEMTEST=n
CONFIG_LV_COLOR_DEPTH_16=y
CONFIG_LV_USE_CLIB_MALLOC=y
CONFIG_LV_USE_CLIB_STRING=y
CONFIG_LV_USE_CLIB_SPRINTF=y
CONFIG_BSP_CO5300_ENABLE_TE=y
```

## runtime/apps/wireless-remote/cardputer/sdkconfig.defaults
```kconfig
CONFIG_IDF_TARGET="esp32s3"
CONFIG_ESP_CONSOLE_USB_SERIAL_JTAG=y
CONFIG_ESP_WIFI_NVS_ENABLED=n
CONFIG_ESP_PHY_CALIBRATION_AND_DATA_STORAGE=n
CONFIG_ESP_WIFI_ESPNOW_MAX_ENCRYPT_NUM=17
CONFIG_ESPTOOLPY_FLASHSIZE_8MB=y
CONFIG_ESP_MAIN_TASK_STACK_SIZE=8192
CONFIG_PARTITION_TABLE_CUSTOM=y
CONFIG_PARTITION_TABLE_CUSTOM_FILENAME="partitions.csv"
CONFIG_PARTITION_TABLE_FILENAME="partitions.csv"
```

## runtime/platform/espnow/standard-peer/sdkconfig.defaults
```kconfig
CONFIG_IDF_TARGET="esp32s3"
CONFIG_ESP_CONSOLE_USB_SERIAL_JTAG=y
CONFIG_ESP_WIFI_NVS_ENABLED=n
CONFIG_ESP_PHY_CALIBRATION_AND_DATA_STORAGE=n
CONFIG_ESP_WIFI_ESPNOW_MAX_ENCRYPT_NUM=17
CONFIG_ESPTOOLPY_FLASHSIZE_8MB=y
```
